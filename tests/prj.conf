## CMakeLists.txt
```
#-------------------------------------------------------------------------------
# Zephyr Example Application
#
# Copyright (c) 2021 Nordic Semiconductor ASA
# SPDX-License-Identifier: Apache-2.0

# set(BOARD qemu_x86_64)
# set(CMAKE_COMPILE_WARNING_AS_ERROR OFF)
set(CMAKE_EXPORT_COMPILE_COMMANDS ON)
cmake_minimum_required(VERSION 3.20)
# find_package(Zephyr COMPONENTS unittest REQUIRED HINTS $ENV{ZEPHYR_BASE})
find_package(Zephyr REQUIRED HINTS $ENV{ZEPHYR_BASE})
project(test_control_lib)
target_include_directories(app PRIVATE src)
# library sources / headers
file (GLOB app_sources
    src/*.cpp
    ../src/*.cpp
    )
target_include_directories(app PRIVATE ../src)
target_sources(app PRIVATE 
    ${app_sources}
    )
```

## prj.conf
```kconfig
# Copyright (c) 2021 Nordic Semiconductor ASA
# SPDX-License-Identifier: Apache-2.0
#
# This file contains selected Kconfig options for the application.

CONFIG_ZTEST=y
CONFIG_ZTEST_NEW_API=y
#CONFIG_COMPILER_WARNINGS_AS_ERRORS=n
CONFIG_CPP=y
CONFIG_STD_CPP2A=y

CONFIG_NEWLIB_LIBC=y
CONFIG_NEWLIB_LIBC_FLOAT_PRINTF=y

CONFIG_CMSIS_DSP=y
CONFIG_CMSIS_DSP_FASTMATH=y
CONFIG_CMSIS_DSP_CONTROLLER=y
CONFIG_FPU=y

CONFIG_HWINFO=y


CONFIG_LOG=y
CONFIG_ASSERT=y

CONFIG_HEAP_MEM_POOL_SIZE=2048
```

## src/main.cpp
```c
#include <zephyr/ztest.h>
#include <zephyr/kernel.h>
// #include <zephyr/console/console.h>
#include <trigo.h>
#include <rst.h>
#include <zephyr/logging/log.h>
#include <pid.h>
#include <pr.h>
#include <filters.h>
#include <transform.h>
LOG_MODULE_REGISTER(test_control, LOG_LEVEL_ERR);

ZTEST_SUITE(trigo, NULL, NULL, NULL, NULL, NULL);

ZTEST(trigo, test_sin)
{
    #include "datas_test_trigo.h"
    float32_t angle;
    float32_t sin_data;
    float32_t ot_sin_data;
    float32_t delta_sin;
    for (uint8_t k = 0; k< ARRAY_SIZE; k++) {
        angle = ((float32_t *)random_angles)[k];
        sin_data = ((float32_t *)random_sin)[k];
        ot_sin_data = ot_sin(angle);
        delta_sin = sin_data - ot_sin_data;
        zexpect_between_inclusive(delta_sin, -2e-5, 2e-5, "sin(%f) !=  %f: %.6f", angle, ot_sin_data, delta_sin);
    }

}

ZTEST(trigo, test_cos)
{
    #include "datas_test_trigo.h"
    float32_t angle;
    float32_t cos_data;
    float32_t ot_cos_data;
    float32_t delta_cos;
    for (uint8_t k = 0; k< ARRAY_SIZE; k++) {
        angle = ((float32_t *)random_angles)[k];
        cos_data = ((float32_t *)random_cos)[k];
        ot_cos_data = ot_cos(angle);
        delta_cos = cos_data - ot_cos_data;
        zexpect_between_inclusive(delta_cos, -2e-5, 2e-5, "cos(%f) !=  %f: %.6f", angle, ot_cos_data, delta_cos);
    }

}

ZTEST(trigo, test_modulo_2pi) {
    #include "datas_test_trigo.h"
    float32_t angle;
    float32_t modulo_data;
    float32_t ot_modulo;
    float32_t delta;
    for (uint8_t k = 0; k< ARRAY_SIZE; k++) {
        angle = ((float32_t *)random_angles)[k];
        modulo_data = ((float32_t *)random_modulo_2pi)[k];
        ot_modulo = ot_modulo_2pi(angle);
        delta = ot_modulo - modulo_data;
        zassert_between_inclusive(delta, -2e-5, 2e-5, "error delta = %f", delta);
    }
}

ZTEST_SUITE(rst, NULL, NULL, NULL, NULL, NULL);

ZTEST(rst, test_fir_update) {
    float32_t value;
    Fir myFir = Fir();
    const float32_t c[4] = {0.25, 0.25, 0.25, 0.25};
    myFir.init(4, c);
    value = myFir.update(1.0);
    zexpect_equal(value, 0.25, "retvalue = %f", value);
    value = myFir.update(1.0);
    zexpect_equal(value, 0.5, "retvalue = %f", value);
    value = myFir.update(1.0);
    zexpect_equal(value, 0.75, "retvalue = %f", value);
    value = myFir.update(1.0);
    zexpect_equal(value, 1.0, "retvalue = %f", value);
    value = myFir.update(1.0);
    zexpect_equal(value, 1.0, "retvalue = %f", value);
}

ZTEST(rst, test_rst_init) {
    RST my_rst;
    const float r[1] = {1.0};
    float s[2] = {1.0, 2.0};
    const float t[1] = {1.0};
    RstParams p(0.1, 1, r, 2, s, 1, t, 0.0, 1.0); 
    int8_t is_ok = my_rst.init(p);
    zexpect_true(is_ok == 0, "init problem");

    float bad_s[2] = {0.0, 2.0};
    p.s = bad_s;
    is_ok = my_rst.init(p);
    zexpect_true(is_ok < 0.0, "init problem");
}

ZTEST(rst, test_rst_update) {
    #include "datas_test_rst.h"
    RST my_rst = RST();
    const uint8_t nr = 3;
    const float R[] = { 0.8914, -1.1521, 0.3732 };
    const uint8_t ns = 6;
    const float S[] = { 0.2, 0.0852, -0.0134, -0.0045, -0.1785, -0.0888 };
    const uint8_t nt = 3;
    const float T[] = { 1.0, -1.3741, 0.4867 };
    RstParams p(5, nr, R, ns, S, nt, T, -5.0, 5.0);
    my_rst.init(p);
    float32_t u;

    for (uint8_t step=0; step < 20; step++)
    {
        u = my_rst.calculateWithReturn(y_ref[step], y_meas[step]);
        zexpect_between_inclusive(u-u_test[step], -0.05, 0.05, "%i, u = %f, u_test = %f", step, u, u_test[step]);
    }

}

ZTEST(rst, test_rst_limit) {
    zassert_ok(false, "rst_limit to implement");
}

ZTEST(rst, test_fir_setcoeff) {
    float32_t value;
    Fir myFir = Fir();
    const float32_t c[4] = {0.25, 0.25, 0.25, 0.25};
    myFir.init(4, c);
    value = myFir.update(1.0);
    zexpect_equal(value, 0.25, "retvalue = %f", value);
    myFir.setCoeff(1, 0.0);
    myFir.setCoeff(2, 0.0);
    myFir.setCoeff(3, 0.0);
    value = myFir.update(1.0);
    zexpect_equal(value, 0.25, "retvalue = %f", value);
    value = myFir.update(1.0);
    zexpect_equal(value, 0.25, "retvalue = %f", value);
}

// PidStandard
struct pid_fixture_t {
    PidParams params;
};

static void *pid_test_setup(void)
{
    static struct pid_fixture_t pid_fixture;
    return &pid_fixture;
}

static void pid_test_before(void *f) {
    pid_fixture_t *pid_fixture = (pid_fixture_t *)f;
    pid_fixture->params.Ts = 5.0;
    pid_fixture->params.Kp = 0.73;
    pid_fixture->params.Ti = 2.735;
    pid_fixture->params.Td = 0.122;
    pid_fixture->params.N = 10.0;
    pid_fixture->params.lower_bound = -0.8;
    pid_fixture->params.upper_bound = 0.8;
}

ZTEST_SUITE(test_pid, NULL, pid_test_setup, pid_test_before, NULL, NULL);

ZTEST_F(test_pid, test_init) {
    Pid pid;
    pid_fixture_t *pid_fixture = (pid_fixture_t *)fixture;
    pid.init(pid_fixture->params);
}

ZTEST_F(test_pid, test_calculate) {
    Pid pid;
    pid_fixture_t *pid_fixture = (pid_fixture_t *)fixture;
    pid.init(pid_fixture->params);
    // data with pid saturation activate
    #include "datas_test_pid_standard.h"
    int n = sizeof(yref) / sizeof(yref[0]);
    for (int k=0; k < n-1; k++)
    {
        float32_t out = pid.calculateWithReturn(yref[k], y[k]);
        zexpect_within(u[k+1], out, 5e-6, "k=%d u[k] = %f, pid u = %f", k, u[k+1], out);
    }

}

ZTEST(test_pid, test_null_derivative) {
    float32_t Ts = 5.0;
    float32_t Kp = 0.73;
    float32_t Ti = 2.735;
    float32_t Td = 0.0;
    float32_t N = 0.0;
    float32_t lower_bound = -0.8;
    float32_t upper_bound = 0.8;
    PidParams params(Ts, Kp, Ti, Td, N, lower_bound, upper_bound);
    Pid pid;
    pid.init(params);
    // data with pid saturation activate
    for (int k=0; k < 10; k++)
    {
        float32_t out = pid.calculateWithReturn(0.1, 0.0);
        bool test = ((*(uint32_t *)&out) >> 20) == 0x7F8;
        zexpect_false(test, "result is inf, %x", *(uint32_t *) &out);
    }

}

ZTEST_F(test_pid, test_bad_init_values) {
    pid_fixture_t *pid_fixture = (pid_fixture_t *)fixture;
    PidParams params = pid_fixture->params;
    //PidParams params(Ts, Kp, Ti, Td, N, lower_bound, upper_bound);
    Pid pid;
    int8_t is_ok; 

    params.Ts = -1.0;
    is_ok = pid.init(params);
    zexpect_true(0 > is_ok, "with Ts<0, it should return -EINVAL");

    params.Ts = 5.0;
    params.Ti = 0.0;
    is_ok = pid.init(params);
    zexpect_true (0 > is_ok, "with Ti==0, it should return -EINVAL");

    params.Ti = 2.735;
    params.Kp = 0.0;
    is_ok = pid.init(params);
    zexpect_true (0 > is_ok, "with Kp==0, it should return -EINVAL");

    params.Kp = 0.73;
    params.lower_bound = 1.0;
    params.upper_bound = -1.0;
    is_ok = pid.init(params);
    zexpect_true (0 > is_ok, "with incorrect bounds  it should return -EINVAL");
}

ZTEST_F(test_pid, test_reset) {
    pid_fixture_t *pid_fixture =  (pid_fixture_t *)fixture;
    Pid pid;
    pid.init(pid_fixture->params);
    pid.reset(-0.4);
    float32_t value = pid.calculateWithReturn(1.0, 1.0);
    zexpect_within(-0.4, value, 1e-7, "value = %f", value);
}

// Pr
ZTEST_SUITE(test_pr, NULL, NULL, NULL, NULL, NULL);


ZTEST(test_pr, test_calculate) {
    float32_t Ts = 9.999999747378752e-05;
    float32_t Kp = 0.20000000298023224;
    float32_t Kr = 300.0;
    float32_t w = 2513.274169921875;
    float32_t phi = 0.3769911229610443;
    float32_t lower_bound = -1.0;
    float32_t upper_bound = 1.0;
    PrParams params(Ts, Kp, Kr, w, phi, lower_bound, upper_bound);
    Pr pr;
    pr.init(params);
    // data with pid saturation activate
    #include "data_test_pr.h"
    int n = sizeof(yref) / sizeof(yref[0]);
    for (int k=0; k < n-1; k++)
    {
        float32_t out = pr.calculateWithReturn(yref[k], y_nosat[k]);
        zexpect_within(u_nosat[k+1], out, 3e-4, "k=%d u[k] = %f, pid u = %f", k, u_nosat[k+1], out);
    }

}

ZTEST_SUITE(test_filters, NULL, NULL, NULL, NULL, NULL);

ZTEST(test_filters, test_lowpass1st) {
    #include "datas_test_lowpass1st.h"
    LowPassFirstOrderFilter aFilter(1.0, 5.0);

    for (int k=0; k < N_DATAS; k++) {
        float32_t yfilt = aFilter.calculateWithReturn(yref[k]);
        zexpect_within(yfilt, y[k], 1e-5, "pb yfilt=%f y[k] = %f, yref[k] = %f", yfilt, y[k], yref[k]);

    }
}

ZTEST(test_filters, test_notchfilter) {
    #include "datas_test_notch_filter.h"
    NotchFilter aFilter(1e-3, 50.0, 5.0);
    for (int k=0; k < N_DATAS; k++) {
        float32_t yfilt = aFilter.calculateWithReturn(yref[k]);
        zexpect_within(yfilt, y[k], 5e-4, "pb yfilt=%f y[k] = %f, yref[k] = %f", yfilt, y[k], yref[k]);

    }
    
}


ZTEST_SUITE(test_transform, NULL, NULL, NULL, NULL, NULL);

ZTEST(test_transform, test_clarke) {
    // 0°
    three_phase_t* Xabc_tests = new three_phase_t[3];
    Xabc_tests[0] = three_phase_t(1.0F, -0.5F, -0.5F);
    Xabc_tests[1] = three_phase_t(0.0F, 0.866025F, -0.866025F);
    Xabc_tests[2] = three_phase_t(.707107F, 0.258819F, -0.965926F);
    clarke_t *Xabo_results = new clarke_t[3];
    Xabo_results[0] = clarke_t(1.0F, 0.0F, 0.0F);
    Xabo_results[1] = clarke_t(0.0F, 1.0F, .0F);
    Xabo_results[2] = clarke_t(.707107F, 0.707107F, 0.0F);

    for (int k=0; k<3;k++) {
        clarke_t Xabo = Transform::clarke(Xabc_tests[k]);
        zexpect_within(Xabo.alpha, Xabo_results[k].alpha, 1e-4, "Xabo.alpha=%f", Xabo_results[k].alpha);
        zexpect_within(Xabo.beta, Xabo_results[k].beta, 1e-4, "Xabo.beta=%f", Xabo_results[k].beta);
        zexpect_within(Xabo.o, Xabo_results[k].o, 1e-4, "Xabo.o = %f", Xabo_results[k].o);
        three_phase_t Xabc_t = Transform::clarke_inverse(Xabo);
        zexpect_within(Xabc_t.a, Xabc_tests[k].a, 1e-4, "Xabc.a=%f", Xabc_tests[k].a);
        zexpect_within(Xabc_t.b, Xabc_tests[k].b, 1e-4, "Xabc.b=%f", Xabc_tests[k].b);
        zexpect_within(Xabc_t.c, Xabc_tests[k].c, 1e-4, "Xabc.c = %f", Xabc_tests[k].c);

    }
}


ZTEST(test_transform, test_dqo) {
    // 0°
    three_phase_t* Xabc_tests = new three_phase_t[3];
    float *angles = new float[3];
    angles[0] = 0.0;
    angles[1] = PI/2.0F;
    angles[2] = PI/4.0F;
    dqo_t *Xdqo_results = new dqo_t[3];
    Xdqo_results[0] = dqo_t(1.0F, 0.0F, 0.0F);
    Xdqo_results[1] = dqo_t(1.0F, 0.0F, 0.0F);
    Xdqo_results[2] = dqo_t(1.0F, 0.0F, 0.0F);

    for (int k=0; k<3;k++) {
        Xabc_tests[k] = three_phase_t(ot_cos(angles[k]), ot_cos(angles[k]-2.0F*PI/3.0F), ot_cos(angles[k]-4.0F*PI/3.0F));
        dqo_t Xdqo = Transform::to_dqo(Xabc_tests[k], angles[k]);
        zexpect_within(Xdqo.d, Xdqo_results[k].d, 2e-5, "error d =%f", -Xdqo_results[k].d + Xdqo.d);
        zexpect_within(Xdqo.q, Xdqo_results[k].q, 1e-5, "error q=%f", -Xdqo_results[k].q + Xdqo.q);
        zexpect_within(Xdqo.o, Xdqo_results[k].o, 1e-5, "error o = %f", -Xdqo_results[k].o + Xdqo.o);
        three_phase_t Xabc_t = Transform::to_threephase(Xdqo, angles[k]);
        zexpect_within(Xabc_t.a, Xabc_tests[k].a, 2e-5, "Xabc.a=%f", Xabc_tests[k].a);
        zexpect_within(Xabc_t.b, Xabc_tests[k].b, 1e-5, "Xabc.b=%f", Xabc_tests[k].b);
        zexpect_within(Xabc_t.c, Xabc_tests[k].c, 1e-5, "Xabc.c = %f", Xabc_tests[k].c);

    }
}
```

## src/data_test_pr.h
```c
#include <arm_math.h>
// datas generated to test behavior
const uint8_t N_DATAS=50;
float32_t yref[50] = {
0,
0.24868990480899810791,
0.48175370693206787109,
0.68454712629318237305,
0.84432798624038696289,
0.95105654001235961914,
0.99802672863006591797,
0.98228722810745239258,
0.90482699871063232422,
0.77051323652267456055,
0.58778524398803710938,
0.36812460422515869141,
0.12533318996429443359,
-0.1253331303596496582,
-0.36812454462051391602,
-0.58778530359268188477,
-0.77051335573196411133,
-0.90482699871063232422,
-0.98228722810745239258,
-0.99802672863006591797,
-0.95105648040771484375,
-0.84432804584503173828,
-0.68454718589782714844,
-0.48175370693206787109,
-0.24868981540203094482,
1.7484555314695171546e-07,
0.24868969619274139404,
0.48175358772277832031,
0.68454712629318237305,
0.84432798624038696289,
0.95105659961700439453,
0.99802672863006591797,
0.98228716850280761719,
0.90482723712921142578,
0.77051341533660888672,
0.58778548240661621094,
0.3681246638298034668,
0.12533324956893920898,
-0.12533330917358398438,
-0.36812472343444824219,
-0.58778548240661621094,
-0.77051347494125366211,
-0.90482681989669799805,
-0.98228716850280761719,
-0.99802672863006591797,
-0.95105659961700439453,
-0.84432798624038696289,
-0.68454706668853759766,
-0.48175352811813354492,
-0.24868963658809661865};

float32_t ysat[50] = {
0,
0,
0,
0.16664098203182220459,
0.4508717954158782959,
0.71838808059692382812,
0.8633359074592590332,
0.85897994041442871094,
0.74740195274353027344,
0.59296935796737670898,
0.43857806921005249023,
0.29010459780693054199,
0.12967468798160552979,
-0.059344429522752761841,
-0.26167583465576171875,
-0.45210891962051391602,
-0.61134523153305053711,
-0.72868323326110839844,
-0.79977571964263916016,
-0.82274931669235229492,
-0.79585897922515869141,
-0.71783483028411865234,
-0.58995735645294189453,
-0.41799628734588623047,
-0.21264947950839996338,
0.011685476638376712799,
0.23901787400245666504,
0.45373103022575378418,
0.64181375503540039062,
0.79137891530990600586,
0.89286971092224121094,
0.93935042619705200195,
0.92700392007827758789,
0.85567229986190795898,
0.72916501760482788086,
0.55514156818389892578,
0.34455525875091552734,
0.11847209930419921875,
-0.094315990805625915527,
-0.28677648305892944336,
-0.46300345659255981445,
-0.62424510717391967773,
-0.76160520315170288086,
-0.85833114385604858398,
-0.89784401655197143555,
-0.87124085426330566406,
-0.78006178140640258789,
-0.63409763574600219727,
-0.44692730903625488281,
-0.23229850828647613525};

float32_t y_nosat[50] = {
0,
0,
0,
0.16664098203182220459,
0.49739992618560791016,
0.86354809999465942383,
1.1186208724975585938,
1.187558293342590332,
1.0887036323547363281,
0.89559155702590942383,
0.67955124378204345703,
0.47323134541511535645,
0.2703240513801574707,
0.050214391201734542847,
-0.19544054567813873291,
-0.45146977901458740234,
-0.68608707189559936523,
-0.86688697338104248047,
-0.97404325008392333984,
-1.0039705038070678711,
-0.96436220407485961914,
-0.86630195379257202148,
-0.71904850006103515625,
-0.52964866161346435547,
-0.30583670735359191895,
-0.059049189090728759766,
0.19481590390205383301,
0.43724068999290466309,
0.65021604299545288086,
0.81894153356552124023,
0.93309742212295532227,
0.98676753044128417969,
0.97777026891708374023,
0.90715312957763671875,
0.77914029359817504883,
0.60132032632827758789,
0.38464498519897460938,
0.14293721318244934082,
-0.10810483992099761963,
-0.35217657685279846191,
-0.57361733913421630859,
-0.75844752788543701172,
-0.89514869451522827148,
-0.97524291276931762695,
-0.99373465776443481445,
-0.94942462444305419922,
-0.84504461288452148438,
-0.68714845180511474609,
-0.48572391271591186523,
-0.25354358553886413574};

float32_t usat[50] = {
0,
0,
0.05667476356029510498,
0.10000000149011611938,
0.10000000149011611938,
0.063664667308330535889,
0.015785237774252891541,
-0.020768182352185249329,
-0.037574633955955505371,
-0.040649250149726867676,
-0.041724417358636856079,
-0.048760283738374710083,
-0.061692096292972564697,
-0.070000000298023223877,
-0.070000000298023223877,
-0.063198618590831756592,
-0.052133660763502120972,
-0.038752306252717971802,
-0.023808844387531280518,
-0.0073095569387078285217,
0.010618912056088447571,
0.029134547337889671326,
0.046684999018907546997,
0.061478726565837860107,
0.072043552994728088379,
0.077549688518047332764,
0.077804513275623321533,
0.073041744530200958252,
0.0637035369873046875,
0.050344694405794143677,
0.033665537834167480469,
0.014587949030101299286,
-0.0057198805734515190125,
-0.025911809876561164856,
-0.044602252542972564697,
-0.060517780482769012451,
-0.070000000298023223877,
-0.070000000298023223877,
-0.067342326045036315918,
-0.065670497715473175049,
-0.0640985146164894104,
-0.05920122191309928894,
-0.048128675669431686401,
-0.030604997649788856506,
-0.0089091295376420021057,
0.0135852862149477005,
0.03404130786657333374,
0.050974875688552856445,
0.064056918025016784668,
0.073371462523937225342};

float32_t u_nosat[50] = {
0,
0,
0.05667476356029510498,
0.11582427471876144409,
0.1344753652811050415,
0.10402147471904754639,
0.045818097889423370361,
-0.0098694171756505966187,
-0.043903533369302749634,
-0.055563692003488540649,
-0.056578580290079116821,
-0.059544347226619720459,
-0.069453038275241851807,
-0.082543201744556427002,
-0.090984612703323364258,
-0.088822975754737854004,
-0.075211964547634124756,
-0.053781706839799880981,
-0.029659165069460868835,
-0.0066085779108107089996,
0.014063152484595775604,
0.032755009829998016357,
0.050034105777740478516,
0.065525695681571960449,
0.077815949916839599609,
0.085158787667751312256,
0.086345233023166656494,
0.081177942454814910889,
0.070388041436672210693,
0.055203352123498916626,
0.036915197968482971191,
0.016675373539328575134,
-0.0044615487568080425262,
-0.025394229218363761902,
-0.04489394649863243103,
-0.06166508793830871582,
-0.074512161314487457275,
-0.082520909607410430908,
-0.085171140730381011963,
-0.082355760037899017334,
-0.074333265423774719238,
-0.061661154031753540039,
-0.045143112540245056152,
-0.025793904438614845276,
-0.0048048137687146663666,
0.016511261463165283203,
0.036799743771553039551,
0.054761718958616256714,
0.069250278174877166748,
0.079350456595420837402};
```

## src/datas_test_lowpass1st.h
```c
#include <arm_math.h>
// datas generated to test behavior
const uint8_t N_DATAS=26;
float32_t y[26] = {
0.17999999999999993783,
0.32759999999999989129,
0.44863199999999986423,
0.54787823999999973879,
0.62926015679999980357,
0.6959933285759998256,
0.75071452943231975485,
0.79558591413450219232,
0.83238044959029178216,
0.86255196866403915923,
0.88729261430451211723,
0.90757994372969985619,
0.92421555385835396645,
0.93785675416385028136,
0.94904253841435715078,
0.95821488149977285254,
0.96573620282981376128,
0.97190368632044732422,
0.97696102278276675257,
0.98110803868186868826,
0.98450859171913229773,
0.98729704520968852854,
0.98958357707194455344,
0.99145853319899457379,
0.99299599722317555273,
0.99425671772300394657};

float32_t yref[26] = {
1,
1,
1,
1,
1,
1,
1,
1,
1,
1,
1,
1,
1,
1,
1,
1,
1,
1,
1,
1,
1,
1,
1,
1,
1,
1};
```

## src/datas_test_notch_filter.h
```c
#include <arm_math.h>
// datas generated to test behavior
const uint8_t N_DATAS=50;
float32_t y[50] = {
0.98453496099665305241,
0.95557363224705904603,
0.93178958828690716665,
0.91531483833115956372,
0.90751102875706768369,
0.90886204434765738291,
0.91895452402957644722,
0.93654544966269515083,
0.95970760096118068461,
0.98603645019281638273,
1.0128966572272670721,
1.0376831845892102724,
1.0580714158404418423,
1.0722325127245826426,
1.0789943315975607518,
1.0779340749774599661,
1.0693958605308797605,
1.0544338366269438989,
1.0346886294421950847,
1.0122110908573715982,
0.98925196310558938251,
0.96803878504812079786,
0.95056193493830853924,
0.9383901468123407863,
0.93253236815031237406,
0.93335783867966459759,
0.9405802917933242524,
0.95330581782403478464,
0.97013780737458410464,
0.9893270954949205942,
1.0089514387743887536,
1.0271061213084999864,
1.042086976027448042,
1.0525484176394066527,
1.0576220299500833644,
1.0569854989822065061,
1.0508767844019368809,
1.0400538572907600532,
1.0257055680974507261,
1.0093237462529407455,
0.99255005671771590059,
0.9770131531474349762,
0.96417212186416256792,
0.9551811098544420453,
0.95078752779572184295,
0.95127260012704262238,
0.95643868174306045926,
0.96564311714614115001,
0.97787393938180777742,
0.99185881930554897767};

float32_t yref[50] = {
1,
1,
1,
1,
1,
1,
1,
1,
1,
1,
1,
1,
1,
1,
1,
1,
1,
1,
1,
1,
1,
1,
1,
1,
1,
1,
1,
1,
1,
1,
1,
1,
1,
1,
1,
1,
1,
1,
1,
1,
1,
1,
1,
1,
1,
1,
1,
1,
1,
1};
```

## src/datas_test_pid_standard.h
```c
#include <arm_math.h>
// datas generated to test standard pid behavior

float32_t y[] = {
0.000000,
0.000000,
0.314775,
0.505696,
0.621496,
0.691732,
0.734332,
0.760170,
0.775842,
0.785347,
0.791113,
0.794610,
0.167180,
-0.109559,
-0.142815,
-0.080149,
-0.018728,
0.010725,
0.014721,
0.008445,
0.002079,
-0.001045,
-0.315409,
-0.506081,
-0.621729,
-0.691873,
-0.734418,
-0.760222,
-0.775874,
-0.785367,
-0.791124,
-0.794617,
-0.167184,
0.109558,
0.142816,
0.080150,
0.018728,
-0.010725,
-0.014721,
-0.008445,
-0.002079};

float32_t yref[] = {
0.0,
1.0,
1.0,
1.0,
1.0,
1.0,
1.0,
1.0,
1.0,
1.0,
1.0,
0.0,
0.0,
0.0,
0.0,
0.0,
0.0,
0.0,
0.0,
0.0,
0.0,
-1.0,
-1.0,
-1.0,
-1.0,
-1.0,
-1.0,
-1.0,
-1.0,
-1.0,
-1.0,
0.0,
0.0,
0.0,
0.0,
0.0,
0.0,
0.0,
0.0,
0.0,
0.0};

float32_t u[] = {
0.000000,
0.000000,
0.800000,
0.800000,
0.800000,
0.800000,
0.800000,
0.800000,
0.800000,
0.800000,
0.800000,
0.800000,
-0.800000,
-0.536150,
-0.194079,
0.016451,
0.075952,
0.056126,
0.020881,
-0.001228,
-0.007734,
-0.005860,
-0.800000,
-0.800000,
-0.800000,
-0.800000,
-0.800000,
-0.800000,
-0.800000,
-0.800000,
-0.800000,
-0.800000,
0.800000,
0.536154,
0.194082,
-0.016449,
-0.075952,
-0.056127,
-0.020881,
0.001228,
0.007734};
```

## src/datas_test_rst.h
```c
    const float32_t y_meas[] = {
        0.0,
        0.0,
        0.0,
        0.0,
        0.0927,
        0.2768115,
        0.46838365166999996,
        0.6320870697977966,
        0.7580480280860717,
        0.8483069495249271,
        0.9094763991085295,
        0.9489564738673566,
        0.9732524567754924,
        0.9874628097727806,
        0.9952858671623939,
        0.999255612632141,
        1.0010225424685206,
        1.0016122446494362,
        1.0016306306538167,
        1.0014155389661936,
        1.0011414097273512
    };

    const float32_t y_ref[] = {
        0.0927,
        0.27682077000000005,
        0.468377720727,
        0.6320217749951879,
        0.7578879307989101,
        0.8480662089246798,
        0.909170004069282,
        0.9485838515178884,
        0.9728132298703527,
        0.9869555584844031,
        0.9947125066036449,
        0.9986204118924399,
        1.0003321696622351,
        1.0008745249709827,
        1.000853810856706,
        1.0006074980444835,
        1.0003092363208494,
        1.0000380214382028,
        0.9998216050046491,
        0.9996624208745153
    };

    const float32_t u_test[] = {
        0.4635,
        0.5497575000000002,
        0.46243475835000075,
        0.4660283839589865,
        0.4322656632721926,
        0.4254725800044541,
        0.41255139260915485,
        0.40835467282912696,
        0.40376830545300835,
        0.4020975222181724,
        0.40070247040837104,
        0.400240591923817,
        0.39993125531282403,
        0.3998858560728993,
        0.399877974195203,
        0.39992532224739663,
        0.3999677086058393,
        0.400011064903506,
        0.4000427301954732,
        0.40006701692850144,
        0.4000830692806654
    };
```

## src/datas_test_trigo.h
```c
#include <arm_math.h>
const uint8_t ARRAY_SIZE = 20;

const uint32_t random_angles[ARRAY_SIZE] = {
    0xc1de4b92,
    0xc2205cd2,
    0x4111d363,
    0x420956d2,
    0xc23de22a,
    0xc1690f3c,
    0x4058a60e,
    0xc1ad2976,
    0x4002e9ac,
    0xc20153a1,
    0xc18c463b,
    0xc23314d7,
    0x3f1b52f5,
    0x4215bc83,
    0x4239d4be,
    0xc240318e,
    0xc189e8b9,
    0xc1fe295c,
    0xc23917be,
    0x42291f6a
};

const uint32_t random_sin[ARRAY_SIZE] = {
    0xbeefcd0b,
    0xbf2e82d0,
    0x3e9c844d,
    0x3e6232d4,
    0x3eae1baf,
    0xbf68cbd9,
    0xbe76edfb,
    0xbead977f,
    0x3f63b133,
    0xbf4b0315,
    0x3f77aff7,
    0xbf357fe1,
    0x3f11f7d6,
    0xbe861b10,
    0x3f1e31f3,
    0x3f4c5ed4,
    0x3f7fcb40,
    0xbeb19d5b,
    0xbf407250,
    0xbf7dcffd
};

const uint32_t random_cos[ARRAY_SIZE] = {
    0xbf622f7c,
    0xbf3b4d3b,
    0xbf73beb8,
    0xbf79ad13,
    0xbf70be6b,
    0xbed4ff22,
    0xbf787205,
    0xbf70d647,
    0xbeea0728,
    0x3f1bf49b,
    0x3e8169e5,
    0x3f3489b2,
    0x3f524ec3,
    0x3f771005,
    0xbf494590,
    0xbf1a2bcd,
    0xbd244f97,
    0x3f701a44,
    0xbf28d206,
    0xbe05949c
};

const uint32_t random_modulo_2pi[ARRAY_SIZE] = {
    0x406841fe,
    0x407910db,
    0x40352dd5,
    0x403ace94,
    0x4032db03,
    0x40891119,
    0x4058a60e,
    0x405f3321,
    0x4002e9ac,
    0x40abc215,
    0x3fa85a8d,
    0x40afd81d,
    0x3f1b52f5,
    0x40c094d7,
    0x401e6df2,
    0x400de4c9,
    0x3fce32b2,
    0x40bdb9b1,
    0x407f81c6,
    0x40929c31};
```
